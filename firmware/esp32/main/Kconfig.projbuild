## firmware/esp32/main/Kconfig.projbuild
```kconfig
menu "Smart Parking ESP32 Configuration"

    config SMART_PARKING_BACKEND_URL
        string "FastAPI Backend REST Base URL"
        default "http://host.wokwi.internal:8000/api/v1"
        help
            Base URL of the FastAPI Backend.
            In Wokwi Simulator, host.wokwi.internal points to the host machine via Wokwi IoT Gateway.
            For physical ESP32, set this to the LAN IP of your PC (e.g. http://192.168.1.100:8000/api/v1).

    config SMART_PARKING_WIFI_SSID
        string "Wi-Fi SSID"
        default "Wokwi-GUEST"
        help
            SSID of the Wi-Fi network. "Wokwi-GUEST" is the default for Wokwi simulation.

    config SMART_PARKING_WIFI_PASSWORD
        string "Wi-Fi Password"
        default ""
        help
            Password for the Wi-Fi network. Keep empty for Wokwi-GUEST.

    config SMART_PARKING_WOKWI_DEMO_ONLY
        bool "WOKWI_DEMO_ONLY: Enable Standalone Wokwi Hardware Simulation Demo Mode"
        default n
        help
            WARNING: FOR WOKWI HARDWARE SIMULATION AND OFFLINE TESTING ONLY.
            DO NOT FLASH THIS FIRMWARE BUILD TO PHYSICAL ESP32 HARDWARE.
            When enabled (y):
            - If Backend is unreachable (Wi-Fi disconnected OR Backend HTTP/DNS fails),
              whitelisted demo RFID cards ("30:A1:23:45" for Entry, "01:02:03:04" for Exit)
              are granted demo access to test Servo barriers and safety sensors in Wokwi.
            - Unauthorized / non-whitelisted cards remain strictly rejected.
            In Production / Hardware Mode, this option MUST be disabled (default n),
            enforcing strict fail-safe rejection if Backend is offline.

    config SMART_PARKING_SIMULATION_OFFLINE_DEMO
        bool "Enable Simulation Offline Demo RFID Override (Legacy Alias)"
        default n
        help
            Legacy alias for SMART_PARKING_WOKWI_DEMO_ONLY.

    config SMART_PARKING_RFID_DEBUG
        bool "Enable Detailed MFRC522 RFID Diagnostics Logging"
        default y
        help
            Enables verbose debug logs for MFRC522 SPI transactions:
            raw UID bytes, FIFO level, valid bits, ErrorReg, ComIrqReg,
            and calculated vs received BCC.

endmenu
```
